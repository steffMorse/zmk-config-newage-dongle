## boards/shields/newage/Kconfig.shield
```kconfig
# Copyright (c) 2020 The ZMK Contributors
# SPDX-License-Identifier: MIT

config SHIELD_NEWAGE_LEFT
    def_bool $(shields_list_contains,newage_left)

config SHIELD_NEWAGE_RIGHT
    def_bool $(shields_list_contains,newage_right)

config SHIELD_NEWAGE_DONGLE
    def_bool $(shields_list_contains,newage_dongle)
```

## config/west.yml
```yaml
manifest:
  remotes:
      # zmk official
    - name: zmkfirmware
      url-base: https://github.com/zmkfirmware
    - name: steffmorse                         #new entry
      url-base: https://github.com/steffMorse  #new entry
  projects:
    - name: zmk
      remote: zmkfirmware
      revision: main
      import: app/west.yml
    - name: nice-view-mod                 #new entry
      remote: steffmorse                       #new entry
      revision: main                      #new entry
  self:
    path: config
```
